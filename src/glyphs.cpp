#include "./glyphs.h"

namespace glcd {

// ================ FUNC ================
GlyphRef findGlyph(uint16_t code, GlyphTables tables) {
    for (const RomGlyph* glyph = tables.rom; glyph; ++glyph) {
        uint16_t utf = pgm_read_word(&glyph->utf);
        if (utf == code) return {nullptr, pgm_read_byte(&glyph->code)};
        if (!utf) break;
    }

    for (const BitmapGlyph* glyph = tables.bitmap; glyph; ++glyph) {
        uint16_t utf = pgm_read_word(&glyph->utf);
        if (utf == code) return {glyph->bitmap, 0};
        if (!utf) break;
    }

    return {nullptr, 0};
}

}  // namespace glcd

// ================ SOFT CYRILLIC ================
static const glcd::RomGlyph rom_cyr_soft[] PROGMEM = {
    {u'А', 'A'},
    {u'В', 'B'},
    {u'Е', 'E'},
    {u'З', '3'},
    {u'К', 'K'},
    {u'М', 'M'},
    {u'Н', 'H'},
    {u'О', 'O'},
    {u'Р', 'P'},
    {u'С', 'C'},
    {u'Т', 'T'},
    {u'Х', 'X'},
    {u'а', 'a'},
    {u'е', 'e'},
    {u'к', 'k'},
    {u'м', 'm'},
    {u'о', 'o'},
    {u'р', 'p'},
    {u'с', 'c'},
    {u'у', 'y'},
    {u'х', 'x'},
    {u'І', 'I'},
    {u'і', 'i'},
    {u'°', 0xDF},
    {0, 0},  // null-terminated
};

static const glcd::BitmapGlyph map_cyr_soft[] PROGMEM = {
    {u'Б', {0x7f, 0x49, 0x49, 0x49, 0x31}},
    {u'Г', {0x7f, 0x01, 0x01, 0x01, 0x01}},
    {u'Д', {0xe0, 0x51, 0x4f, 0x41, 0xff}},
    {u'Ж', {0x77, 0x08, 0x3e, 0x08, 0x77}},
    {u'И', {0x7f, 0x10, 0x08, 0x04, 0x7f}},
    {u'Й', {0x7c, 0x21, 0x12, 0x09, 0x7c}},
    {u'Л', {0x20, 0x40, 0x3e, 0x01, 0x7f}},
    {u'П', {0x7f, 0x01, 0x01, 0x01, 0x7f}},
    {u'У', {0x27, 0x48, 0x48, 0x48, 0x3f}},
    {u'Ф', {0x1c, 0x22, 0x7f, 0x22, 0x1c}},
    {u'Ц', {0x7f, 0x40, 0x40, 0x40, 0xff}},
    {u'Ч', {0x07, 0x08, 0x08, 0x08, 0x7f}},
    {u'Ш', {0x7f, 0x40, 0x7f, 0x40, 0x7f}},
    {u'Щ', {0x7f, 0x40, 0x7f, 0x40, 0xff}},
    {u'Ъ', {0x01, 0x7f, 0x48, 0x48, 0x30}},
    {u'Ы', {0x7f, 0x48, 0x30, 0x00, 0x7f}},
    {u'Ь', {0x7f, 0x48, 0x48, 0x30, 0x00}},
    {u'Э', {0x22, 0x41, 0x49, 0x49, 0x3e}},
    {u'Ю', {0x7f, 0x08, 0x3e, 0x41, 0x3e}},
    {u'Я', {0x46, 0x29, 0x19, 0x09, 0x7f}},
    {u'б', {0x3c, 0x4a, 0x4a, 0x49, 0x31}},
    {u'в', {0x7c, 0x54, 0x54, 0x28, 0x00}},
    {u'г', {0x7c, 0x04, 0x04, 0x04, 0x00}},
    {u'д', {0x31, 0x49, 0x4a, 0x4a, 0x3c}},
    {u'ж', {0x6c, 0x10, 0x7c, 0x10, 0x6c}},
    {u'з', {0x20, 0x44, 0x54, 0x54, 0x28}},
    {u'и', {0x7c, 0x20, 0x10, 0x08, 0x7c}},
    {u'й', {0x78, 0x42, 0x24, 0x12, 0x78}},
    {u'л', {0x70, 0x08, 0x04, 0x78, 0x00}},
    {u'н', {0x7c, 0x10, 0x10, 0x10, 0x7c}},
    {u'п', {0x7c, 0x04, 0x04, 0x04, 0x7c}},
    {u'т', {0x04, 0x04, 0x7c, 0x04, 0x04}},
    {u'ф', {0x18, 0x24, 0x7e, 0x24, 0x18}},
    {u'ц', {0x7c, 0x40, 0x40, 0x7c, 0xc0}},
    {u'ч', {0x0c, 0x10, 0x10, 0x10, 0x7c}},
    {u'ш', {0x7c, 0x40, 0x7c, 0x40, 0x7c}},
    {u'щ', {0x7c, 0x40, 0x7c, 0x40, 0xfc}},
    {u'ъ', {0x04, 0x7c, 0x50, 0x50, 0x20}},
    {u'ы', {0x7c, 0x50, 0x50, 0x20, 0x7c}},
    {u'ь', {0x7c, 0x50, 0x50, 0x20, 0x00}},
    {u'э', {0x00, 0x44, 0x54, 0x54, 0x38}},
    {u'ю', {0x7c, 0x10, 0x38, 0x44, 0x38}},
    {u'я', {0x08, 0x54, 0x34, 0x14, 0x7c}},
    {u'Ё', {0x7c, 0x55, 0x54, 0x55, 0x44}},
    {u'Є', {0x3e, 0x49, 0x49, 0x41, 0x22}},
    {u'Ї', {0x00, 0x45, 0x7c, 0x45, 0x00}},
    {u'Ў', {0x26, 0x48, 0x49, 0x48, 0x3e}},
    {u'Ґ', {0x7e, 0x02, 0x02, 0x02, 0x01}},
    {u'ё', {0x38, 0x55, 0x54, 0x55, 0x18}},
    {u'є', {0x38, 0x54, 0x54, 0x44, 0x00}},
    {u'ї', {0x00, 0x45, 0x7c, 0x41, 0x00}},
    {u'ў', {0x0c, 0x51, 0x52, 0x51, 0x3c}},
    {u'ґ', {0x7c, 0x04, 0x04, 0x04, 0x02}},
    {0, {}},  // null-terminated
};

const glcd::GlyphTables GTABLE_CYR_SOFT = {
    rom_cyr_soft,
    map_cyr_soft,
};

// ================ HARD CYRILLIC ================
static const glcd::RomGlyph rom_cyr_hard[] PROGMEM = {
    {u'А', 'A'},
    {u'Б', 0xA0},
    {u'В', 'B'},
    {u'Г', 0xA1},
    {u'Д', 0xE0},
    {u'Е', 'E'},
    {u'Ё', 0xA2},
    {u'Ж', 0xA3},
    {u'З', 0xA4},
    {u'И', 0xA5},
    {u'Й', 0xA6},
    {u'К', 'K'},
    {u'Л', 0xA7},
    {u'М', 'M'},
    {u'Н', 'H'},
    {u'О', 'O'},
    {u'П', 0xA8},
    {u'Р', 'P'},
    {u'С', 'C'},
    {u'Т', 'T'},
    {u'У', 0xA9},
    {u'Ф', 0xAA},
    {u'Х', 'X'},
    {u'Ц', 0xE1},
    {u'Ч', 0xAB},
    {u'Ш', 0xAC},
    {u'Щ', 0xE2},
    {u'Ъ', 0xAD},
    {u'Ы', 0xAE},
    {u'Ь', 'b'},
    {u'Э', 0xAF},
    {u'Ю', 0xB0},
    {u'Я', 0xB1},

    {u'а', 'a'},
    {u'б', 0xB2},
    {u'в', 0xB3},
    {u'г', 0xB4},
    {u'д', 0xE3},
    {u'е', 'e'},
    {u'ё', 0xB5},
    {u'ж', 0xB6},
    {u'з', 0xB7},
    {u'и', 0xB8},
    {u'й', 0xB9},
    {u'к', 0xBA},
    {u'л', 0xBB},
    {u'м', 0xBC},
    {u'н', 0xBD},
    {u'о', 'o'},
    {u'п', 0xBE},
    {u'р', 'p'},
    {u'с', 'c'},
    {u'т', 0xBF},
    {u'у', 'y'},
    {u'ф', 0xE4},
    {u'х', 'x'},
    {u'ц', 0xE5},
    {u'ч', 0xC0},
    {u'ш', 0xC1},
    {u'щ', 0xE6},
    {u'ъ', 0xC2},
    {u'ы', 0xC3},
    {u'ь', 0xC4},
    {u'э', 0xC5},
    {u'ю', 0xC6},
    {u'я', 0xC7},

    {u'°', 0xDF},
    {0, 0},  // null-terminated
};

const glcd::GlyphTables GTABLE_CYR_HARD = {
    rom_cyr_hard,
    nullptr,
};
